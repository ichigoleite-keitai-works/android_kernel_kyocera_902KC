/* This software is contributed or developed by KYOCERA Corporation.
 * (C) 2019 KYOCERA Corporation
 *
 * This program is free software; you can redistribute it and/or modify
 * it under the terms of the GNU General Public License version 2 and
 * only version 2 as published by the Free Software Foundation.
 *
 * This program is distributed in the hope that it will be useful,
 * but WITHOUT ANY WARRANTY; without even the implied warranty of
 * MERCHANTABILITY or FITNESS FOR A PARTICULAR PURPOSE.  See the
 * GNU General Public License for more details.
 */

/* msm8909.dtsi */

/ {

    reserved-memory {
		#address-cells = <2>;
		#size-cells = <2>;
		ranges;

		ramoops@8e000000 {
			#address-cells = <2>;
			#size-cells = <2>;
			compatible = "ramoops";
			reg = <0x8e000000 0x100000>; // 1MB at 0x8e000000
			record-size = <0x10000>; // 64kB per record
			console-size = <0x10000>; // 64kB for console output
			pmsg-size = <0x1000>; // 4kB for user messages
		};
	};
};

